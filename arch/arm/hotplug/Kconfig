## arch/arm/hotplug/Kconfig
```kconfig
config BLU_PLUG
	bool "Dynamic hotplug driver"
	depends on HOTPLUG_CPU
	default y
	help
	  The Dynamic hotplug driver automatically online/offline CPUs proportional to system load.
```
